## config/boards/shields/apollo_macropad/Kconfig.defconfig
```kconfig
if SHIELD_APOLLO_MACROPAD

config ZMK_KEYBOARD_NAME
    default "Apollo MacroPad"

# ポインティングデバイス(トラックボール)機能を有効化
config ZMK_POINTING
    default y

# トラックボール(PMW3610)の通信に使用するSPIを有効化
config SPI
    default y

endif
```

## config/west.yml
```yaml
manifest:
  remotes:
    - name: zmkfirmware
      url-base: https://github.com/zmkfirmware
    - name: badjeff
      url-base: https://github.com/badjeff
    - name: mctechnology
      url-base: https://github.com/mctechnology17
  projects:
    - name: zmk
      remote: zmkfirmware
      revision: v0.3
      import: app/west.yml
    - name: zmk-pmw3610-driver
      remote: badjeff
      revision: zmk-0.3
    - name: zmk-nice-oled
      remote: mctechnology
      revision: main
  self:
    path: config
```
