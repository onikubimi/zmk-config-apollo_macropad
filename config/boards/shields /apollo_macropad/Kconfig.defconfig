## config/boards/shields /apollo_macropad/Kconfig.defconfig
```kconfig
if SHIELD_APOLLO_MACROPAD
config ZMK_KEYBOARD_NAME
    default "Apollo_MacroPad"

config ZMK_SPLIT_ROLE_CENTRAL
    default y
endif
```

## config/boards/shields/apollo_macropad/Kconfig.shield
```kconfig
config SHIELD_APOLLO_MACROPAD
    def_bool $(shields_list_contains,apollo_macropad)
```
